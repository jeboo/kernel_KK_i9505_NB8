## arch/arm/configs/jf_eur_defconfig
```kconfig
CONFIG_MACH_JF_EUR=y
CONFIG_EXTRA_FIRMWARE="audience-es325-fw-eur.bin"
CONFIG_EXTRA_FIRMWARE_DIR="firmware"
CONFIG_INSIDESECURE_VPNCLIENT=y
CONFIG_LOCALVERSION_AUTO=n
CONFIG_LOCALVERSION="-Jeboo_Kernel_v3.1-i"
```
